#include "imx93-11x11-evk.dts"

&lpspi8 {
	fsl,spi-num-chipselects = <1>;
	pinctrl-names = "default";
	pinctrl-0 = <&pinctrl_lpspi8>;
	assigned-clocks = <&clk IMX93_CLK_LPSPI8>;
	assigned-clock-parents = <&clk IMX93_CLK_SYS_PLL_PFD0_DIV2>;
	assigned-clock-rates = <100000000>;
	cs-gpios = <&gpio2 12 GPIO_ACTIVE_LOW>;
	///delete-property/ dma-names;
	///delete-property/ dmas;
	status = "okay";

	spidev0: spi@0 {
                reg = <0>;
                compatible = "lwn,bk4";
                debix,buffer = <16384>;
                spi-max-frequency = <1000000>;
        };
};

&iomuxc {
	pinctrl_lpspi8: lpspi8grp {
		fsl,pins = <
			MX93_PAD_GPIO_IO12__GPIO2_IO12          0x3fe
			MX93_PAD_GPIO_IO13__LPSPI8_SIN          0x3fe
			MX93_PAD_GPIO_IO14__LPSPI8_SOUT         0x3fe
			MX93_PAD_GPIO_IO15__LPSPI8_SCK          0x3fe
		>;
	};

};
